## Kconfig
```kconfig
mainmenu "ZMK Config"

# Include all shields
rsource "boards/shields/*/Kconfig.shield"
```

## boards/shields/arcturis/Kconfig.shield
```kconfig
config SHIELD_ARCTURIS
    def_bool true
    help
      Root shield for Arcturis keyboard (shared configs)
```
