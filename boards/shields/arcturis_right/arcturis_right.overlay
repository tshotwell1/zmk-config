#include <dt-bindings/zmk/matrix_transform.h>
#include "../arcturis/arcturis.dtsi"
/{
    chosen {
        zmk,kscan = &default_kscan;
        zmk,matrix-transform = &default_transform;
    };

    kscan0: kscan {
        compatible = "zmk,kscan-gpio-matrix";
        label = "default_kscan";
        diode-direction = "row2col";

        row-gpios = <&pro_micro 7 (GPIO_ACTIVE_HIGH | GPIO_PULL_DOWN)>,
                    <&pro_micro 8 (GPIO_ACTIVE_HIGH | GPIO_PULL_DOWN)>,
                    <&pro_micro 9 (GPIO_ACTIVE_HIGH | GPIO_PULL_DOWN)>,
                    <&pro_micro 10 (GPIO_ACTIVE_HIGH | GPIO_PULL_DOWN)>;

        col-gpios = <&pro_micro 6 GPIO_ACTIVE_HIGH>,
                    <&pro_micro 5 GPIO_ACTIVE_HIGH>,
                    <&pro_micro 15 GPIO_ACTIVE_HIGH>,
                    <&pro_micro 3 GPIO_ACTIVE_HIGH>,
                    <&pro_micro 2 GPIO_ACTIVE_HIGH>;
    };

    default_transform {
        col-offset = <5>;
    };
};